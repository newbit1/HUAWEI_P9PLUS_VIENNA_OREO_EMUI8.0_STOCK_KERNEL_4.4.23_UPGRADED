## drivers/huawei_platform/power/hw_ptm/Kconfig
```kconfig
config HW_PTM
    bool "Huawei Power Thermal Monitor"
    default n
    help
        Huawei PTM, please choose it.

config HW_PTM_K3V5
    bool "Huawei Power Thermal Monitor For K3V5"
    default n
    help
        Huawei PTM, please choose it for K3V5.

config HW_PTM_K3V6
    bool "Huawei Power Thermal Monitor For K3V6"
    default n
    help
        Huawei PTM, please choose it for K3V6.

config HW_PTM_K3V7
    bool "Huawei Power Thermal Monitor For K3V7"
    default n
    help
        Huawei PTM, please choose it for K3V7.
```
